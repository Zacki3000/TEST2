## main/Kconfig.projbuild
```kconfig
menu "Example Configuration"

    orsource "$IDF_PATH/examples/common_components/env_caps/$IDF_TARGET/Kconfig.env_caps"

    config HW_VARIANT
        string "Hardware variant"
        default "custom"
        help
            Any hardware with the same HW_VARIANT is assumed to be binary compatible and can receive OTA updates.
            If you set this to "custom", this means that the hardware is not binary compatible with any other known
            hardware, and you will not receive (potentially incompatible) OTA updates.

    config ENABLE_SD
        bool "Enable SD card"
        default y
        help
            General toggle for enabling/disabling SD card related functionality.

    config SNIFFER_STORE_HISTORY
        bool "Store command history into flash"
        default y
        help
            Linenoise line editing library provides functions to save and load command history.
            If this option is enabled, initializes a FAT filesystem and uses it to store command history.

    choice SNIFFER_PCAP_DESTINATION
        prompt "Select destination to store pcap file"
        default SNIFFER_PCAP_DESTINATION_SD
        help
            Select where to store the pcap file.
            Currently support storing files to SD card or to host via JTAG interface with 'Trace memory' enabled.
        config SNIFFER_PCAP_DESTINATION_SD
            bool "SD Card"
            depends on ENABLE_SD
            help
                Store pcap file to SD card.
        config SNIFFER_PCAP_DESTINATION_JTAG
            bool "JTAG (App Trace)"
            depends on APPTRACE_DEST_JTAG
            help
                Store pcap file to host via JTAG interface.
        config SNIFFER_PCAP_DESTINATION_MEMORY
            bool "Memory"
            help
                Store pcap file to memory.
    endchoice

    if ENABLE_SD
        choice SNIFFER_SD_MODE
            prompt "Select SD card work mode"
            default SNIFFER_SD_SDMMC_MODE
            help
                Select which peripheral SD card should use.
            config SNIFFER_SD_SDMMC_MODE
                bool "SDMMC"
                depends on SOC_SDMMC_HOST_SUPPORTED
                help
                    Use SDMMC mode (Not support on esp32c3).
            config SNIFFER_SD_SPI_MODE
                bool "SPI"
                help
                    Use SPI mode.
        endchoice
        menu "SD card pin configuration (SPI)"
            depends on SNIFFER_SD_SPI_MODE

            config SNIFFER_PIN_MOSI
                int "MOSI GPIO number"
                range ENV_GPIO_RANGE_MIN ENV_GPIO_OUT_RANGE_MAX
                default 7
                help
                    GPIO pin number for SPI MOSI (Master Out Slave In).

            config SNIFFER_PIN_MISO
                int "MISO GPIO number"
                range ENV_GPIO_RANGE_MIN ENV_GPIO_IN_RANGE_MAX
                default 2
                help
                    GPIO pin number for SPI MISO (Master In Slave Out).

            config SNIFFER_PIN_CLK
                int "CLK GPIO number"
                range ENV_GPIO_RANGE_MIN ENV_GPIO_OUT_RANGE_MAX
                default 6
                help
                    GPIO pin number for SPI Clock.

            config SNIFFER_PIN_CS
                int "CS GPIO number"
                range ENV_GPIO_RANGE_MIN ENV_GPIO_OUT_RANGE_MAX
                default 27
                help
                    GPIO pin number for SPI Chip Select.
        endmenu
        config SNIFFER_MOUNT_POINT
            string "SD card mount point in the filesystem"
            default "/sdcard"
            help
                Specify the mount point in the VFS (Virtual File System) for SD card.
    endif
    if SNIFFER_PCAP_DESTINATION_SD
        config SNIFFER_PCAP_FILE_NAME_MAX_LEN
            int "Max name length of pcap file"
            default 32
            help
                Specify maximum name length of pcap file.
    endif

    if SNIFFER_PCAP_DESTINATION_MEMORY
        config SNIFFER_PCAP_MEMORY_SIZE
            int "Memory size of the '.pcap' file in memory"
            default 4096
            help
                Max memory size to storage packet in memory.
    endif

    config SNIFFER_WORK_QUEUE_LEN
        int "Length of sniffer work queue"
        default 128
        help
            The sniffer callback function should not do heavy work, so we put all heavy IO operation to another task.
            The task gets some basic info of sniffer packet via queue.
            Here you should specify the length of queue.

    config SNIFFER_TASK_STACK_SIZE
        int "Stack size of sniffer task"
        default 4096
        help
            Stack size of sniffer task.

    config SNIFFER_TASK_PRIORITY
        int "Priority of sniffer task"
        default 2
        help
            Priority of sniffer task.

    config LEDSTRIP_PIN
        int "LED strip pin"
        range ENV_GPIO_RANGE_MIN ENV_GPIO_OUT_RANGE_MAX
        default 26
        help
            GPIO number where the LED strip is connected

    config ENABLE_TEMPERATURE
        bool "Enable I2C temperature sensor"
        default y

    config ENABLE_TX
        bool "Enable transmitting frames (EXPERIMENTAL)"
        default n
        help
            This feature is highly experimental and has not been designed or tested for compliance with ETSI EN 302 571.

            Only transmit frames in a controlled lab environment.

    config ENABLE_TX_TEST
        bool "Enable tx_test command"
        depends on ENABLE_TX
        default n
        help
            The tx_test command sends a garbage frame 10 times per second. You likely won't need this.

    config ENABLE_ITS
        bool "Enable ITS"
        depends on ENABLE_TX
        default n
        help
            Enable sending CAMs with the position received via GNSS. If more features are added, the dependency on ENABLE_TX
            may be removed.

    config ENABLE_GNSS
        bool "Enable GNSS positioning and time sync"
        default n
        help
            Enables receiving of position and synchronization of system time via an external GNSS receiver.

            Currently only tested to work with the ATGM336H module.

    menu "GNSS pin configuration (UART + PPS)"
        depends on ENABLE_GNSS

        config GNSS_PIN_TX
            int "TX GPIO number"
            range ENV_GPIO_RANGE_MIN ENV_GPIO_OUT_RANGE_MAX
            default 5
            help
                GPIO pin number for TX.

        config GNSS_PIN_RX
            int "RX GPIO number"
            range ENV_GPIO_RANGE_MIN ENV_GPIO_IN_RANGE_MAX
            default 3
            help
                GPIO pin number for RX.

        config GNSS_PIN_PPS
            int "PPS GPIO number"
            range ENV_GPIO_RANGE_MIN ENV_GPIO_OUT_RANGE_MAX
            default 4
            help
                GPIO pin number for PPS (Pulse Per Second).
    endmenu

endmenu
```
